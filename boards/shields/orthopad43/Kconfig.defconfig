## boards/shields/orthopad43/Kconfig.defconfig
```kconfig
if SHIELD_ORTHOPAD43_LEFT

config ZMK_SPLIT_ROLE_CENTRAL
    default y

endif # SHIELD_ORTHOPAD43_LEFT


if SHIELD_ORTHOPAD43_LEFT || SHIELD_ORTHOPAD43_RIGHT

config ZMK_KEYBOARD_NAME
    default "orthopad43"

config ZMK_SPLIT
   default y

endif # SHIELD_ORTHOPAD43_LEFT || SHIELD_ORTHOPAD43_RIGHT
```

## boards/shields/orthopad43/Kconfig.shield
```kconfig
config SHIELD_ORTHOPAD43_LEFT
    def_bool $(shields_list_contains,orthopad43_left)

config SHIELD_ORTHOPAD43_RIGHT
    def_bool $(shields_list_contains,orthopad43_right)
```
